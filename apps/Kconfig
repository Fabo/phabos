## apps/Kconfig
```kconfig
# Copyright (C) 2014-2015 Fabien Parent. All rights reserved.
# Author: Fabien Parent <parent.f@gmail.com>
#
# Provided under the three clause BSD license found in the LICENSE file.

menu "Apps"

config APP_LSDEV
    bool "lsdev"
    default n

config APP_FREE
    bool "free"
    default n

config APP_PS
    bool "ps"
    default n

config APP_I2C
    bool "i2c"
    depends on I2C
    default n

endmenu
```

## arch/arm/mach-stm32/Kconfig
```kconfig
# Copyright (C) 2014-2015 Fabien Parent. All rights reserved.
# Author: Fabien Parent <parent.f@gmail.com>
#
# Provided under the three clause BSD license found in the LICENSE file.

config MACH_NAME
    string
    default "stm32"

choice
    prompt "Board"

    config BOARD_LM3S6965
        bool "STM32F4 Discovery"
        select CPU_ARM_CORTEX_M3
endchoice

config MACH_LINKER_SCRIPT
    string
    default "stm32f4-discovery"
```

## drivers/gpio/Kconfig
```kconfig
# Copyright (C) 2014-2015 Fabien Parent. All rights reserved.
# Author: Fabien Parent <parent.f@gmail.com>
#
# Provided under the three clause BSD license found in the LICENSE file.

menuconfig TCA6408
    bool "TCA6408 support"

if TCA6408
config TCA6408_TESTAPP
    bool "TCA6408 test app"
endif

config UNIFIED_GPIO
    bool "Unified GPIO controller"
    default n
```
